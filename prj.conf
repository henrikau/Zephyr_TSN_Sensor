## CMakeLists.txt
```
# SPDX-License-Identifier: Apache-2.0

cmake_minimum_required(VERSION 3.20.0)
find_package(Zephyr REQUIRED HINTS $ENV{ZEPHYR_BASE})

project(avb_sensor_node)

target_sources(app PRIVATE src/main.c src/common.c src/gyro.c src/accel.c src/network.c src/avtp.c src/avtp_stream.c)
```

## Kconfig
```
# AVB Sensor Node for K64F w/AGM01 shield

# Copyright (c) 2023 SINTEF Digital
# SPDX-License-Identifier: Apache-2.0

mainmenu "AVB Sensor Node configuration"

config NET_VLAN_TAG_AVB
	int "Virtrual LAN tag used for AVB sensor traffic"
	default 100
	range 0 4094
	depends on NET_VLAN
	help
	  Set virtual LAN tag (id) that is used for AVB/TSN sensor traffic.

source "Kconfig.zephyr"
```

## sample.yaml
```
sample:
  name: AVB Gyro
```

## prj.conf
```kconfig
# Provide some heap space
CONFIG_HEAP_MEM_POOL_SIZE=2048

CONFIG_BUILD_OUTPUT_HEX=y
CONFIG_STDOUT_CONSOLE=y
CONFIG_PRINTK=y
CONFIG_NET_SHELL=y

CONFIG_STDOUT_CONSOLE=y
CONFIG_LOG=y
CONFIG_LOG_MODE_DEFERRED=y
CONFIG_I2C=y
CONFIG_SENSOR=y
CONFIG_SENSOR_LOG_LEVEL_DBG=y

CONFIG_CBPRINTF_FP_SUPPORT=y

## --------------------------------------
## Sensors
##
## FXOS8700: Magnetometer and temperature
CONFIG_FXOS8700_MODE_HYBRID=y
CONFIG_FXOS8700_TEMP=y
CONFIG_FXOS8700_TRIGGER_OWN_THREAD=y
##
## FXAS21002: Gyro
CONFIG_FXAS21002_TRIGGER_OWN_THREAD=y

## --------------------------------------
## Network and gPTP settings
CONFIG_NETWORKING=y
CONFIG_NET_SOCKETS=y
CONFIG_NET_SOCKETS_PACKET=y
CONFIG_NET_SOCKETS_POSIX_NAMES=y

CONFIG_NET_LOG=y
CONFIG_LOG=y
CONFIG_NET_IPV6=y
CONFIG_NET_IPV4=y
CONFIG_NET_DHCPV4=n
CONFIG_NET_UDP=y
CONFIG_NET_TCP=y
CONFIG_NET_STATISTICS=y
CONFIG_NET_STATISTICS_USER_API=y

CONFIG_TEST_RANDOM_GENERATOR=y

CONFIG_NET_PKT_TX_COUNT=32
CONFIG_NET_PKT_RX_COUNT=32
CONFIG_NET_BUF_TX_COUNT=32
CONFIG_NET_BUF_RX_COUNT=32
CONFIG_NET_IF_UNICAST_IPV6_ADDR_COUNT=5
CONFIG_NET_IF_MCAST_IPV6_ADDR_COUNT=5
CONFIG_NET_IF_UNICAST_IPV4_ADDR_COUNT=1
CONFIG_NET_MAX_CONTEXTS=10

CONFIG_INIT_STACKS=y

CONFIG_NET_SHELL=y

## Ethernet is needed for gPTP
CONFIG_NET_L2_ETHERNET=y
CONFIG_NET_CONFIG_NEED_IPV6=y
CONFIG_NET_CONFIG_NEED_IPV4=y
CONFIG_NET_CONFIG_SETTINGS=y
CONFIG_NET_CONFIG_MY_IPV6_ADDR="2001:db8::2"
CONFIG_NET_CONFIG_MY_IPV4_ADDR="192.168.10.2"
CONFIG_NET_CONFIG_PEER_IPV6_ADDR="fe80::21b:21ff:fee4:6664"
CONFIG_NET_CONFIG_PEER_IPV4_ADDR="192.168.10.1"
CONFIG_NET_CONFIG_MY_IPV4_GW="192.168.10.1"
CONFIG_NET_CONFIG_MY_IPV4_NETMASK="255.255.255.0"

## gPTP settings
CONFIG_NET_GPTP=y
CONFIG_NET_GPTP_STATISTICS=y
CONFIG_NET_GPTP_GM_CAPABLE=y
CONFIG_PTP_CLOCK_MCUX=y
CONFIG_NET_GPTP_NEIGHBOR_PROP_DELAY_THR=1000000

## How many traffic classes to enable
CONFIG_NET_TC_TX_COUNT=8
CONFIG_NET_TC_RX_COUNT=4

## Enable priority support in net_context
CONFIG_NET_CONTEXT_PRIORITY=y
CONFIG_NET_GPTP_PATH_TRACE_ELEMENTS=16

# Enable VLAN and default to VLAN 2
CONFIG_NET_VLAN_TAG_AVB=2
CONFIG_NET_VLAN=y
CONFIG_NET_VLAN_COUNT=1
```

## src/main.c
```c
#include <zephyr/kernel.h>
#include <stdio.h>
#include <zephyr/drivers/sensor.h>
#include "common.h"

int main(void)
{
	bool startup_err = false;

	/* Setup Time first */
	gptp_init();

	struct avb_sensor_data *data = alloca(sizeof(*data));
	if (data_init(data, 5000)) {
		printf("Failed initializing data container\n");
		startup_err = true;
	}

	/* System is running, but data-capture is not yet ready  */
	data->running = true;
	data->ready = false;

	/* ------------------------------------------------------
	 * FXAS21002 - Gyro
	 * Collector runs in own thread waiting for gyro_init() to be called
	 */
	if (gyro_init(data) != 0) {
		printf("Failed starting gyro!\n");
		startup_err = true;
	}

	/* ------------------------------------------------------
	 * FXOS8700 (accel, magn, temp)
	 */
	if (accel_init(data) != 0) {
		printf("Failed starting accel/magn/temp!\n");
		startup_err = true;
	}


	/* ------------------------------------------------------
	 * network setup, making addresses, buffers, CBS etc ready
	 *
	 * accel reads data at 100Hz (10ms)
	 */
	if (network_init(data, 10*NSEC_PER_MSEC, CLASS_NONE) != 0) {
		printf("Failed starting network\n");
		startup_err = true;
	}

	if (startup_err) {
		printf("Startup errors exists, aborting..\n");

		/* Signal all threads to pack it up */
		data->running = false;
		return -1;
	}
	/* All subsystems have initialized ok */
	data->ready = true;

	/* ------------------------------------------------------
	 * Print loop, 4 Hz
	 */
	while (1) {
		k_sleep(K_MSEC(250));

/* To enable this, call west with: -DEXTRA_CFLAGS="-DDEBUG=1" */
#ifdef DEBUG
		if (data_get(data) == 0) {
			double diff_ms = (int64_t)(data->accel_ts - data->gyro_ts) / 1e6;
			printf("[%"PRIu64"] (%8.3f ms) ", data->gyro_ts, diff_ms);

			printf("GX=%10.3f GY=%10.3f GZ=%10.3f ",
				sensor_value_to_double(&data->gyro[0]),
				sensor_value_to_double(&data->gyro[1]),
				sensor_value_to_double(&data->gyro[2]));

			printf("AX=%10.6f AY=%10.6f AZ=%10.6f ",
				sensor_value_to_double(&data->accel[0]),
				sensor_value_to_double(&data->accel[1]),
				sensor_value_to_double(&data->accel[2]));

			/* Print mag x,y,z data */
			printf("MX=%10.6f MY=%10.6f MZ=%10.6f ",
				sensor_value_to_double(&data->magn[0]),
				sensor_value_to_double(&data->magn[1]),
				sensor_value_to_double(&data->magn[2]));

			/* Print accel x,y,z and mag x,y,z data */
			printf("T=%10.6f", sensor_value_to_double(&data->temp));
			printf("\n");
			data_put(data);
		}
#endif /* DEBUG */
	}
	return 0;
}

K_THREAD_DEFINE(GYRO_COLLECTOR,  1024, gyro_collector    , NULL, NULL, NULL, 3, 0, 0);
K_THREAD_DEFINE(ACCEL_COLLECTOR, 1024, accel_collector   , NULL, NULL, NULL, 2, 0, 0);
K_THREAD_DEFINE(NETWORK_SENDER,  1024, network_sender    , NULL, NULL, NULL, 1, 0, 0);
K_THREAD_DEFINE(CBS_REFILLER,    2048, network_cbs_refill, NULL, NULL, NULL, 0, 0, 0);
```

## src/accel.c
```c
#include <zephyr/kernel.h>
#include <zephyr/drivers/sensor.h>
#include <stdio.h>
#include "common.h"

static struct avb_sensor_data *_data = NULL;
static const struct device * dev_a = NULL;
static bool valid = false;

K_SEM_DEFINE(sem_a, 0, 1);	/* starts off "not available" */

static void th_accel(const struct device *dev,
		const struct sensor_trigger *trigger)
{
	if (sensor_sample_fetch(dev)) {
		printf("[ACCEL] sensor_sample_fetch() FAILED\n");
		return;
	}
	k_sem_give(&sem_a);
}


int accel_init(struct avb_sensor_data *sensor_data)
{
	if (!sensor_data)
		return -1;

	_data = sensor_data;

	dev_a = DEVICE_DT_GET_ONE(nxp_fxos8700);
	if (!device_is_ready(dev_a)) {
		printf("Device %s is not ready\n", dev_a->name);
		return -1;
	}

	/* Run sensor at 100Hz (commented out: 6 Hz  */
	struct sensor_value attr_a = {
		.val1 = 200, // 6
		.val2 = 0,   // 250000
	};

	if (sensor_attr_set(dev_a, SENSOR_CHAN_ALL,
				SENSOR_ATTR_SAMPLING_FREQUENCY, &attr_a)) {
		printf("Could not set sampling frequency for %s\n", dev_a->name);
		return -1;
	}

	struct sensor_trigger trig_a = {
		.type = SENSOR_TRIG_DATA_READY,
		.chan = SENSOR_CHAN_ACCEL_XYZ,
	};
	if (sensor_trigger_set(dev_a, &trig_a, th_accel)) {
		printf("Could not set trigger for %s\n", dev_a->name);
		return -1;
	}

	printf("Device %s is ready and triggers configured.\n", dev_a->name);
	valid = true;
	return 0;
}


void accel_collector(void)
{
	/* Wait for accel_init() to be called */
	do {
		k_sleep(K_SECONDS(1));
	} while (!valid);

	while (valid && data_valid(_data)) {
		k_sem_take(&sem_a, K_FOREVER);
		uint64_t ts = gptp_ts();
		if (data_get(_data) == 0) {
			sensor_channel_get(dev_a, SENSOR_CHAN_ACCEL_XYZ, &_data->accel[0]);
			sensor_channel_get(dev_a, SENSOR_CHAN_MAGN_XYZ, &_data->magn[0]);
			sensor_channel_get(dev_a, SENSOR_CHAN_DIE_TEMP, &_data->temp);
			_data->accel_ts = ts;
			_data->accel_ctr++;
			data_put(_data);
		}
	}
}
```

## src/avtp.c
```c
/*
 * Copyright (c) 2017, Intel Corporation
 *
 * Redistribution and use in source and binary forms, with or without
 * modification, are permitted provided that the following conditions are met:
 *
 *    * Redistributions of source code must retain the above copyright notice,
 *      this list of conditions and the following disclaimer.
 *    * Redistributions in binary form must reproduce the above copyright
 *      notice, this list of conditions and the following disclaimer in the
 *      documentation and/or other materials provided with the distribution.
 *    * Neither the name of Intel Corporation nor the names of its contributors
 *      may be used to endorse or promote products derived from this software
 *      without specific prior written permission.
 *
 * THIS SOFTWARE IS PROVIDED BY THE COPYRIGHT HOLDERS AND CONTRIBUTORS "AS IS"
 * AND ANY EXPRESS OR IMPLIED WARRANTIES, INCLUDING, BUT NOT LIMITED TO, THE
 * IMPLIED WARRANTIES OF MERCHANTABILITY AND FITNESS FOR A PARTICULAR PURPOSE ARE
 * DISCLAIMED. IN NO EVENT SHALL THE COPYRIGHT OWNER OR CONTRIBUTORS BE LIABLE
 * FOR ANY DIRECT, INDIRECT, INCIDENTAL, SPECIAL, EXEMPLARY, OR CONSEQUENTIAL
 * DAMAGES (INCLUDING, BUT NOT LIMITED TO, PROCUREMENT OF SUBSTITUTE GOODS OR
 * SERVICES; LOSS OF USE, DATA, OR PROFITS; OR BUSINESS INTERRUPTION) HOWEVER
 * CAUSED AND ON ANY THEORY OF LIABILITY, WHETHER IN CONTRACT, STRICT LIABILITY,
 * OR TORT (INCLUDING NEGLIGENCE OR OTHERWISE) ARISING IN ANY WAY OUT OF THE USE
 * OF THIS SOFTWARE, EVEN IF ADVISED OF THE POSSIBILITY OF SUCH DAMAGE.
 */

//#include <arpa/inet.h>
#include <zephyr/net/net_ip.h>
#include <stddef.h>

#include "avtp.h"
#include "util.h"

#define SHIFT_SUBTYPE			(31 - 7)
#define SHIFT_VERSION			(31 - 11)

#define MASK_SUBTYPE			(BITMASK(8) << SHIFT_SUBTYPE)
#define MASK_VERSION			(BITMASK(3) << SHIFT_VERSION)

int avtp_pdu_get(const struct avtp_common_pdu *pdu, enum avtp_field field,
								uint32_t *val)
{
	uint32_t bitmap, mask;
	uint8_t shift;

	if (!pdu || !val)
		return -EINVAL;

	switch (field) {
	case AVTP_FIELD_SUBTYPE:
		mask = MASK_SUBTYPE;
		shift = SHIFT_SUBTYPE;
		break;
	case AVTP_FIELD_VERSION:
		mask = MASK_VERSION;
		shift = SHIFT_VERSION;
		break;
	default:
		return -EINVAL;
	}

	bitmap = ntohl(pdu->subtype_data);

	*val = BITMAP_GET_VALUE(bitmap, mask, shift);

	return 0;
}

int avtp_pdu_set(struct avtp_common_pdu *pdu, enum avtp_field field,
								uint32_t value)
{
	uint32_t bitmap, mask;
	uint8_t shift;

	if (!pdu)
		return -EINVAL;

	switch (field) {
	case AVTP_FIELD_SUBTYPE:
		mask = MASK_SUBTYPE;
		shift = SHIFT_SUBTYPE;
		break;
	case AVTP_FIELD_VERSION:
		mask = MASK_VERSION;
		shift = SHIFT_VERSION;
		break;
	default:
		return -EINVAL;
	}

	bitmap = ntohl(pdu->subtype_data);

	BITMAP_SET_VALUE(bitmap, value, mask, shift);

	pdu->subtype_data = htonl(bitmap);

	return 0;
}
```

## src/avtp_stream.c
```c
/*
 * Copyright (c) 2019, Intel Corporation
 *
 * Redistribution and use in source and binary forms, with or without
 * modification, are permitted provided that the following conditions are met:
 *
 *    * Redistributions of source code must retain the above copyright notice,
 *      this list of conditions and the following disclaimer.
 *    * Redistributions in binary form must reproduce the above copyright
 *      notice, this list of conditions and the following disclaimer in the
 *      documentation and/or other materials provided with the distribution.
 *    * Neither the name of Intel Corporation nor the names of its contributors
 *      may be used to endorse or promote products derived from this software
 *      without specific prior written permission.
 *
 * THIS SOFTWARE IS PROVIDED BY THE COPYRIGHT HOLDERS AND CONTRIBUTORS "AS IS"
 * AND ANY EXPRESS OR IMPLIED WARRANTIES, INCLUDING, BUT NOT LIMITED TO, THE
 * IMPLIED WARRANTIES OF MERCHANTABILITY AND FITNESS FOR A PARTICULAR PURPOSE ARE
 * DISCLAIMED. IN NO EVENT SHALL THE COPYRIGHT OWNER OR CONTRIBUTORS BE LIABLE
 * FOR ANY DIRECT, INDIRECT, INCIDENTAL, SPECIAL, EXEMPLARY, OR CONSEQUENTIAL
 * DAMAGES (INCLUDING, BUT NOT LIMITED TO, PROCUREMENT OF SUBSTITUTE GOODS OR
 * SERVICES; LOSS OF USE, DATA, OR PROFITS; OR BUSINESS INTERRUPTION) HOWEVER
 * CAUSED AND ON ANY THEORY OF LIABILITY, WHETHER IN CONTRACT, STRICT LIABILITY,
 * OR TORT (INCLUDING NEGLIGENCE OR OTHERWISE) ARISING IN ANY WAY OUT OF THE USE
 * OF THIS SOFTWARE, EVEN IF ADVISED OF THE POSSIBILITY OF SUCH DAMAGE.
 */

//#include <arpa/inet.h>
#include <zephyr/net/net_ip.h>
#include <stddef.h>
#include <string.h>

#include "avtp.h"
#include "avtp_stream.h"
#include "util.h"

#define SHIFT_SV			(31 - 8)
#define SHIFT_MR			(31 - 12)
#define SHIFT_TV			(31 - 15)
#define SHIFT_SEQ_NUM			(31 - 23)
#define SHIFT_STREAM_DATA_LEN		(31 - 15)

#define MASK_SV				(BITMASK(1) << SHIFT_SV)
#define MASK_MR				(BITMASK(1) << SHIFT_MR)
#define MASK_TV				(BITMASK(1) << SHIFT_TV)
#define MASK_SEQ_NUM			(BITMASK(8) << SHIFT_SEQ_NUM)
#define MASK_TU				(BITMASK(1))
#define MASK_STREAM_DATA_LEN		(BITMASK(16) << SHIFT_STREAM_DATA_LEN)

static int get_field_value(const struct avtp_stream_pdu *pdu,
				enum avtp_stream_field field, uint64_t *val)
{
	uint32_t bitmap, mask;
	uint8_t shift;

	switch (field) {
	case AVTP_STREAM_FIELD_SV:
		mask = MASK_SV;
		shift = SHIFT_SV;
		bitmap = ntohl(pdu->subtype_data);
		break;
	case AVTP_STREAM_FIELD_MR:
		mask = MASK_MR;
		shift = SHIFT_MR;
		bitmap = ntohl(pdu->subtype_data);
		break;
	case AVTP_STREAM_FIELD_TV:
		mask = MASK_TV;
		shift = SHIFT_TV;
		bitmap = ntohl(pdu->subtype_data);
		break;
	case AVTP_STREAM_FIELD_SEQ_NUM:
		mask = MASK_SEQ_NUM;
		shift = SHIFT_SEQ_NUM;
		bitmap = ntohl(pdu->subtype_data);
		break;
	case AVTP_STREAM_FIELD_TU:
		mask = MASK_TU;
		shift = 0;
		bitmap = ntohl(pdu->subtype_data);
		break;
	case AVTP_STREAM_FIELD_STREAM_DATA_LEN:
		mask = MASK_STREAM_DATA_LEN;
		shift = SHIFT_STREAM_DATA_LEN;
		bitmap = ntohl(pdu->packet_info);
		break;
	default:
		return -EINVAL;
	}

	*val = BITMAP_GET_VALUE(bitmap, mask, shift);

	return 0;
}

int avtp_stream_pdu_get(const struct avtp_stream_pdu *pdu,
				enum avtp_stream_field field, uint64_t *val)
{
	int res;

	if (!pdu || !val)
		return -EINVAL;

	switch (field) {
	case AVTP_STREAM_FIELD_SV:
	case AVTP_STREAM_FIELD_MR:
	case AVTP_STREAM_FIELD_TV:
	case AVTP_STREAM_FIELD_SEQ_NUM:
	case AVTP_STREAM_FIELD_TU:
	case AVTP_STREAM_FIELD_STREAM_DATA_LEN:
		res = get_field_value(pdu, field, val);
		break;
	case AVTP_STREAM_FIELD_TIMESTAMP:
		*val = ntohl(pdu->avtp_time);
		res = 0;
		break;
	case AVTP_STREAM_FIELD_STREAM_ID:
		*val = sys_be64_to_cpu(pdu->stream_id);
		res = 0;
		break;
	default:
		return -EINVAL;
	}

	return res;
}

static int set_field_value(struct avtp_stream_pdu *pdu,
				enum avtp_stream_field field, uint64_t val)
{
	uint32_t bitmap, mask;
	uint8_t shift;
	void *ptr;

	switch (field) {
	case AVTP_STREAM_FIELD_SV:
		mask = MASK_SV;
		shift = SHIFT_SV;
		ptr = &pdu->subtype_data;
		break;
	case AVTP_STREAM_FIELD_MR:
		mask = MASK_MR;
		shift = SHIFT_MR;
		ptr = &pdu->subtype_data;
		break;
	case AVTP_STREAM_FIELD_TV:
		mask = MASK_TV;
		shift = SHIFT_TV;
		ptr = &pdu->subtype_data;
		break;
	case AVTP_STREAM_FIELD_SEQ_NUM:
		mask = MASK_SEQ_NUM;
		shift = SHIFT_SEQ_NUM;
		ptr = &pdu->subtype_data;
		break;
	case AVTP_STREAM_FIELD_TU:
		mask = MASK_TU;
		shift = 0;
		ptr = &pdu->subtype_data;
		break;
	case AVTP_STREAM_FIELD_STREAM_DATA_LEN:
		mask = MASK_STREAM_DATA_LEN;
		shift = SHIFT_STREAM_DATA_LEN;
		ptr = &pdu->packet_info;
		break;
	default:
		return -EINVAL;
	}

	bitmap = get_unaligned_be32(ptr);

	BITMAP_SET_VALUE(bitmap, val, mask, shift);

	put_unaligned_be32(bitmap, ptr);

	return 0;
}

int avtp_stream_pdu_set(struct avtp_stream_pdu *pdu,
				enum avtp_stream_field field, uint64_t value)
{
	int res;

	if (!pdu)
		return -EINVAL;

	switch (field) {
	case AVTP_STREAM_FIELD_SV:
	case AVTP_STREAM_FIELD_MR:
	case AVTP_STREAM_FIELD_TV:
	case AVTP_STREAM_FIELD_SEQ_NUM:
	case AVTP_STREAM_FIELD_TU:
	case AVTP_STREAM_FIELD_STREAM_DATA_LEN:
		res = set_field_value(pdu, field, value);
		break;
	case AVTP_STREAM_FIELD_TIMESTAMP:
		pdu->avtp_time = htonl(value);
		res = 0;
		break;
	case AVTP_STREAM_FIELD_STREAM_ID:
		pdu->stream_id = sys_cpu_to_be64(value);
		res = 0;
		break;
	default:
		return -EINVAL;
	}

	return res;
}

int avtp_stream_pdu_init(struct avtp_stream_pdu *pdu)
{
	int res;

	if (!pdu)
		return -EINVAL;

	memset(pdu, 0, sizeof(struct avtp_stream_pdu));

	res = avtp_pdu_set((struct avtp_common_pdu *) pdu, AVTP_FIELD_SUBTYPE, AVTP_SUBTYPE_EF_STREAM);
	if (res < 0)
		return res;

	res = avtp_stream_pdu_set(pdu, AVTP_STREAM_FIELD_SV, 1);
	if (res < 0)
		return res;

	return 0;
}
```

## src/avtp_stream.h
```c
/*
 * Copyright (c) 2019, Intel Corporation
 *
 * Redistribution and use in source and binary forms, with or without
 * modification, are permitted provided that the following conditions are met:
 *
 *    * Redistributions of source code must retain the above copyright notice,
 *      this list of conditions and the following disclaimer.
 *    * Redistributions in binary form must reproduce the above copyright
 *      notice, this list of conditions and the following disclaimer in the
 *      documentation and/or other materials provided with the distribution.
 *    * Neither the name of Intel Corporation nor the names of its contributors
 *      may be used to endorse or promote products derived from this software
 *      without specific prior written permission.
 *
 * THIS SOFTWARE IS PROVIDED BY THE COPYRIGHT HOLDERS AND CONTRIBUTORS "AS IS"
 * AND ANY EXPRESS OR IMPLIED WARRANTIES, INCLUDING, BUT NOT LIMITED TO, THE
 * IMPLIED WARRANTIES OF MERCHANTABILITY AND FITNESS FOR A PARTICULAR PURPOSE ARE
 * DISCLAIMED. IN NO EVENT SHALL THE COPYRIGHT OWNER OR CONTRIBUTORS BE LIABLE
 * FOR ANY DIRECT, INDIRECT, INCIDENTAL, SPECIAL, EXEMPLARY, OR CONSEQUENTIAL
 * DAMAGES (INCLUDING, BUT NOT LIMITED TO, PROCUREMENT OF SUBSTITUTE GOODS OR
 * SERVICES; LOSS OF USE, DATA, OR PROFITS; OR BUSINESS INTERRUPTION) HOWEVER
 * CAUSED AND ON ANY THEORY OF LIABILITY, WHETHER IN CONTRACT, STRICT LIABILITY,
 * OR TORT (INCLUDING NEGLIGENCE OR OTHERWISE) ARISING IN ANY WAY OUT OF THE USE
 * OF THIS SOFTWARE, EVEN IF ADVISED OF THE POSSIBILITY OF SUCH DAMAGE.
 */

#pragma once

#include <errno.h>
#include <stdint.h>

#pragma GCC visibility push(hidden)

#ifdef __cplusplus
extern "C" {
#endif

/* XXX: To be able to use the functions provided by this header,
 * without needing to direct "translate" enum values, it is necessary
 * that any format specific enum have the following fields (excluding
 * AVTP_STREAM_FIELD_MAX) in the same order as below. For instance,
 * some `enum avtp_newformat_field` would start like:
 *
 * enum avtp_newformat_field {
 *      AVTP_NEWFORMAT_FIELD_SV,
 *      AVTP_NEWFORMAT_FIELD_MR,
 *      // (other stream fields here)
 *      AVTP_NEWFORMAT_FIELD_XYZ,
 *      // (other newformat specific fields here)
 * }
 *
 * This way, one can simply cast enums when calling functions from this
 * header:
 *
 * avtp_stream_pdu_get(pdu, (enum avtp_stream_field) field, val);
 *
 * Otherwise, the mapping step would be necessary before the calls.
 */
enum avtp_stream_field {
	AVTP_STREAM_FIELD_SV,
	AVTP_STREAM_FIELD_MR,
	AVTP_STREAM_FIELD_TV,
	AVTP_STREAM_FIELD_SEQ_NUM,
	AVTP_STREAM_FIELD_TU,
	AVTP_STREAM_FIELD_STREAM_ID,
	AVTP_STREAM_FIELD_TIMESTAMP,
	AVTP_STREAM_FIELD_STREAM_DATA_LEN,
	AVTP_STREAM_FIELD_MAX
};

/* Get value from Stream AVTPDU field.
 * @pdu: Pointer to PDU struct.
 * @field: PDU field to be retrieved.
 * @val: Pointer to variable which the retrieved value should be saved.
 *
 * Returns:
 *    0: Success.
 *    -EINVAL: If any argument is invalid.
 */
int avtp_stream_pdu_get(const struct avtp_stream_pdu *pdu,
				enum avtp_stream_field field, uint64_t *val);

/* Set value from Stream AVTPDU field.
 * @pdu: Pointer to PDU struct.
 * @field: PDU field to be set.
 * @val: Value to be set.
 *
 * Returns:
 *    0: Success.
 *    -EINVAL: If any argument is invalid.
 */
int avtp_stream_pdu_set(struct avtp_stream_pdu *pdu,
				enum avtp_stream_field field, uint64_t val);

int avtp_stream_pdu_init(struct avtp_stream_pdu *pdu);

#ifdef __cplusplus
}
#endif

#pragma GCC visibility pop
```

## src/common.c
```c
#include <zephyr/logging/log.h>
LOG_MODULE_REGISTER(avb_sensor_node, LOG_LEVEL_DBG);

#include <zephyr/kernel.h>

#include <string.h> 		/* memset */
#include <errno.h>
#include <stdio.h>

#include "common.h"

int data_init(struct avb_sensor_data *data, int timeout_us)
{
	if (!data)
		return -ENOMEM;

	if (k_mutex_init(&data->lock)) {
		printf("Failed initializing data lock.\n");
		return -EINVAL;
	}

	data->timeout = K_USEC(timeout_us);
	data_get(data);

	memset(data->accel, 0, sizeof(struct sensor_value)*3);
	memset(data->magn, 0, sizeof(struct sensor_value)*3);
	memset(&data->temp, 0, sizeof(struct sensor_value));
	data->accel_ts = 0;

	memset(data->gyro, 0, sizeof(struct sensor_value)*3);
	data->gyro_ts = 0;

	data_put(data);
	return 0;
}

int data_get(struct avb_sensor_data *data)
{
	if (!data)
		return -EINVAL;
	int retries = 3;

retry:
	int res = k_mutex_lock(&data->lock, data->timeout);
	if (res == -EAGAIN && retries-- > 0)
		goto retry;

	return res;
}
int data_put(struct avb_sensor_data *data)
{
	if (!data)
		return -EINVAL;
	return k_mutex_unlock(&data->lock);
}

int data_wait_ready(struct avb_sensor_data *data, int timeout_ms)
{
	int wait_ms = 0;
	bool ready = false;

	if (!data)
		return -EINVAL;

	do {
		if (data_get(data) == 0) {
			ready = data->ready;
			data_put(data);
		}
		k_sleep(K_MSEC(50));
		wait_ms += 50;
		if (wait_ms > timeout_ms)
			return -ETIMEDOUT;
	} while (!ready);

	return 0;
}

bool data_valid(struct avb_sensor_data *data)
{
	if (!data)
		return false;

	bool valid = false;
	if (data_get(data) == 0) {
		valid = data->running;
		data_put(data);
	}
	return valid;
}

/* Copied from zephyr/samples/net/gptp/src/main.c */
#include <zephyr/net/gptp.h>
#include <zephyr/net/net_core.h>
#include <zephyr/net/net_l2.h>
#include <zephyr/net/net_if.h>
#include <zephyr/net/ethernet.h>

uint64_t gptp_ts(void)
{
	struct net_ptp_time ptpts;
	bool gm_present;
	gptp_event_capture(&ptpts, &gm_present);
	return ptpts.second * NSEC_PER_SEC + ptpts.nanosecond;
}

static struct gptp_phase_dis_cb phase_dis;
static void gptp_phase_dis_cb(uint8_t *gm_identity,
			      uint16_t *time_base,
			      struct gptp_scaled_ns *last_gm_ph_change,
			      double *last_gm_freq_change)
{
	char output[sizeof("xx:xx:xx:xx:xx:xx:xx:xx")];
	static uint8_t id[8];

	if (memcmp(id, gm_identity, sizeof(id))) {
		memcpy(id, gm_identity, sizeof(id));

		LOG_DBG("GM %s last phase %d.%" PRId64 "",
			gptp_sprint_clock_id(gm_identity, output, sizeof(output)),
			last_gm_ph_change->high,
			last_gm_ph_change->low);
	}
}

void gptp_init(void)
{
	gptp_register_phase_dis_cb(&phase_dis, gptp_phase_dis_cb);
}
```

## src/common.h
```c
#pragma once
#include <zephyr/kernel.h>
#include <zephyr/drivers/sensor.h>
enum avb_stream_class {
	CLASS_NONE = 0,		/* do not use PCP and VLAN */
	CLASS_A = 8000,		/* 125us - 8kHz */
	CLASS_B = 4000		/* 250us - 4kHz */
};

struct avb_sensor_data {
	struct k_mutex lock;
	k_timeout_t timeout;

	/* System flag to indicate if we are running and ready to start */
	bool ready;
	bool running;

	/* Accel, magnetometer & temp from once device */
	struct sensor_value accel[3];
	struct sensor_value magn[3];
	struct sensor_value temp;
	uint64_t accel_ts;
	uint64_t accel_ctr;

	/* GYRO is read from another device */
	struct sensor_value gyro[3];
	uint64_t gyro_ts;
	uint64_t gyro_ctr;
};

/*
 * Sensor value payload
 */
struct sensor_set {
	int64_t magn[3];
	int64_t gyro[3];
	int64_t accel[3];
	int64_t temp;
	uint64_t gyro_ts_ns;
	uint64_t accel_ts_ns;
	uint64_t sent_ts_ns;
} __attribute__((packed));

int data_init(struct avb_sensor_data *d, int timeout_us);
int data_get(struct avb_sensor_data *d);
int data_put(struct avb_sensor_data *d);

/* Wait for data to become available.
 * Needed at:
 *    - startup, when sensor setup is still running
 *    - error, if one or more of the sensors are unavailable.
 */
int data_wait_ready(struct avb_sensor_data *data, int timeout_ms);

/* If system becomes invalid, indicates to threads that they should close down.
 *
 * If data is invalid, cannot continue.
 */
bool data_valid(struct avb_sensor_data *data);

uint64_t gptp_ts(void);
void gptp_init(void);

int gyro_init(struct avb_sensor_data *sensor_data);
void gyro_collector(void);

int accel_init(struct avb_sensor_data *sensor_data);
void accel_collector(void);

/* We are currently sending *a single stream*
 *
 * Initialize the network, set addresses, ready CBS credit calculation
 * etc.
 *
 * sensor_data: containing struct for data. We expect the data to be
 * updated asynhcronously and will send whatever's in the buffer when
 * CBS allows us to
 *
 * tx_interval: Target interval. This is used as input to the CBS
 * machinery to compute the correct idleSlope which in turn will send
 * data at the desired rate.
 */
int network_init(struct avb_sensor_data *sensor_data,
		uint64_t tx_interval_ns,
		enum avb_stream_class sc);

/* Worker sending data from as quickly as CBS will allow it to.
 *
 * The design hinges on a single sender (this thread) sending sensor
 * data of a known size. It does not currently support multiple outgoing
 * streams.
 */
void network_sender(void);

/* Low-pri worker that drains the Rx buffer of a socket.
 *
 * This is a know bug found by Einar, that when gPTP runs, it places the
 * iface in promiscous mode, and the gPTP driver does not properly drain
 * the incming packages, resulting in overflowing buffers.
 *
 * [00:12:17.839,000] <err> net_pkt: Data buffer (68) allocation failed.
 *
 */
void network_rx_drain(void);

/* Worker that periodically refills the credits. Once credits reaches >=
 * 0, potential waiters are signalled.
 */
void network_cbs_refill(void);
```

## src/gyro.c
```c
#include <zephyr/kernel.h>
#include <zephyr/drivers/sensor.h>
#include <stdio.h>
#include "common.h"

static struct avb_sensor_data *_data = NULL;
static const struct device * dev_g = NULL;
static bool valid = false;

K_SEM_DEFINE(sem_g, 0, 1);	/* starts off "not available" */
static void th_gyro(const struct device *dev,
		const struct sensor_trigger *trigger)
{
	if (sensor_sample_fetch(dev)) {
		printf("[GYRO] sensor_sample_fetch() FAILED\n");
		return;
	}
	k_sem_give(&sem_g);
}


int gyro_init(struct avb_sensor_data *sensor_data)
{
	if (!sensor_data)
		return -1;

	_data = sensor_data;

	dev_g = DEVICE_DT_GET_ANY(nxp_fxas21002);
	if (dev_g == NULL || !device_is_ready(dev_g)) {
		printf("Device %s is not ready.\n", dev_g->name);
		return -1;
	}

	struct sensor_trigger trig_g = {
		.type = SENSOR_TRIG_DATA_READY,
		.chan = SENSOR_CHAN_GYRO_XYZ,
	};
	if (sensor_trigger_set(dev_g, &trig_g, th_gyro)) {
		printf("Could not set trigger for %s.\n", dev_g->name);
		return -1;
	}

	printf("Device %s is ready and triggers configured.\n", dev_g->name);
	valid = true;
	return 0;
}


void gyro_collector(void)
{
	/* Wait for gyro_init() to complete */
	do {
		k_sleep(K_SECONDS(1));
	} while (!valid);

	while (valid && data_valid(_data)) {
		k_sem_take(&sem_g, K_FOREVER);
		uint64_t ts = gptp_ts();

		data_get(_data);
		sensor_channel_get(dev_g, SENSOR_CHAN_GYRO_XYZ, &_data->gyro[0]);
		_data->gyro_ts = ts;
		_data->gyro_ctr++;
		data_put(_data);
	}
	printf("[GYRO] Closing down gyro-collector.\n");
}
```

## src/network.c
```c
#include "common.h"
#include "avtp.h"
#include <zephyr/net/socket.h>
#include <zephyr/net/ethernet.h>
#include <zephyr/net/net_core.h>
#include <zephyr/net/net_l2.h>
#include <zephyr/net/net_if.h>
#include "avtp.h"
#include "avtp_stream.h"

#include <stdio.h>		/* printf() */
#define PREAMBLE_SZ		7
#define SFD_SZ			1
#define CRC_SZ			4
#define IPG_SZ			12
#define L1_SZ			(PREAMBLE_SZ + SFD_SZ + CRC_SZ + IPG_SZ)
#define L2_SZ			14
#define VLAN_SZ			 4
#define DATA_LEN		sizeof(struct sensor_set)
#define PDU_SIZE		(sizeof(struct avtp_stream_pdu) + DATA_LEN)
#define STREAM_ID		42

struct net_info {
	/* iface related fields
	 */
	int max_mtu;
	int queue;

	/* Complete streamid, including host MAC address */
	union {
		uint64_t u64;
		unsigned char u8[8];
	} stream_id;

	/* CB Settings */
	enum avb_stream_class sc;
	uint64_t portTxRate;

	/* Refill-rate, bits/sec */
	int64_t idleSlope;

	/* timer period for refill task */
	int64_t idleSlope_period_ns;
	int idleSlope_rate;
	int idleSlope_refill;

	/* each timer period refill amount */
	int64_t idleSlope_period;

	int64_t sendSlope;

	/* Credits (in bits) */
	int credit;
	int maxFrameSize;
	int loCredit;
	int hiCredit;
	uint64_t tx_interval_ns;


	/* Tx Priority */
	struct net_context *avb_ctx;
	/*
	 * Reference to sensor data. The collector-threads will feed data into
	 * this whenever their sensor is ready. When we can transmit, we reserve
	 * this, copy out data and send.
	 */
	struct avb_sensor_data *data;
};
static struct net_info ninfo = {0};


/* cbs_can_tx
 * We use this to signal that credits are available.
 *
 * Upper limit is 1, i.e. we can give this semaphore as many times as we
 * like, but we will never have a queue of 'unused locks' which could
 * lead to a massive overspending of credits.
 */
K_SEM_DEFINE(cbs_can_tx, 0, 1);

/* change this to mutex? */
K_SEM_DEFINE(cbs_credit_lock, 1, 1);

/* Worker that periodically refills the credits. Once credits reaches >=
 * 0, potential waiters are signalled.
 */

/* CBS refill signal */
K_SEM_DEFINE(cbs_timer_sem,0,1);
static struct k_timer cbs_timer;
void cbs_timeout(struct k_timer *timer_id) {
	k_sem_give(&cbs_timer_sem);
}

/* Dedicated worker that periodically refills the Tx-credit.
 *
 * As we do not have HW assisted CBS, this this is done in SW and to
 * reduce the overhead, the interval is higher than the observation
 * interval for both class A and B.
 *
 */
void network_cbs_refill(void)
{
	/* Wait for network_init() to be called, i.e. setting ->data */
	do {
		k_sleep(K_MSEC(100));
	} while (ninfo.data == NULL);

	/*
	 * Run periodically at X Hz (find this in .1BA/.1Q#L
	 * FIXME: add a timer (prematurely) stopped callback
	 *
	 * Currently this is hardcoded to run at 100Hz, we replenish
	 * with 1 framesize every 10ms.
	 *
	 * This is *not* the correct way.
	 */
	k_timer_init(&cbs_timer, cbs_timeout, NULL);

	/* Refill with 100Hz, try to avoid too high overhead whilst
	 * testing and debugging.
	 */
	printf("Running refill-task every %u usec\n", (int)(ninfo.idleSlope_period_ns / 1e3));
	k_timer_start(&cbs_timer, K_USEC(0), K_USEC((int)(ninfo.idleSlope_period_ns / 1e3)));

	while (1) {
		k_sem_take(&cbs_credit_lock, K_FOREVER);

		/* 1. Replenish credit
		 *
		 * In 802.1Q, idleSlope is used to describe the rate of
		 * replensihing credits for a particular Stream
		 * Class. Class A expects to transmit frames every 125us
		 * (8kHz), B at 4kHz.
		 *
		 * This does not scale particularly well to a SW-only
		 * approach, so we need network_init() to have
		 * calculated idleSlope and _rate appropriately.
		 */

		/* If we're below, we increment regardless of queue. */
		if (ninfo.credit < 0) {
			ninfo.credit += ninfo.idleSlope_refill;
		} else if (ninfo.queue > 0) {
			/* queued and credit was > 0, so increment, but cap at hiCredit */
			ninfo.credit += ninfo.idleSlope_refill;
			if (ninfo.credit > ninfo.hiCredit)
				ninfo.credit = ninfo.hiCredit;
		}

		/* 2. notify waiters */
		if(ninfo.credit >= 0) {
			if (ninfo.queue > 0) {
				k_sem_give(&cbs_can_tx);
			} else {
				/* no waiters, release excess credits */
				ninfo.credit = 0;
			}
		}
		k_sem_give(&cbs_credit_lock);

		/* 3. Wait for timer and goto #1*/
		k_sem_take(&cbs_timer_sem, K_FOREVER);
	}
}


/* Grab hold of the credit value before transmitting.
 *
 * If the credit is 0, this function will block and the caller must wait
 * for the credits to be replensished.
 *
 * Once it returs (provided 0), the caller now has the 'credit lock' and
 * is the sole thread capable of transmitting.
 */
int cbs_credit_get(void)
{
	if (k_sem_take(&cbs_credit_lock, K_FOREVER) == 0) {
		ninfo.queue++;
		k_sem_give(&cbs_credit_lock);
		return k_sem_take(&cbs_can_tx, K_FOREVER);
	}
	return -EBUSY;
}

/* Decrement the credit with the consumed size of the transmitted
 * data. The functino will also release the 'credit-lock'
 *
 * Size in bytes
 */
int cbs_credit_put(int payload_sz)
{
	if (k_sem_take(&cbs_credit_lock, K_FOREVER) == 0) {
		/* We have sent, less pressure on the queue */
		ninfo.queue--;

		/* reduce credit with transmitted data
		 *
		 * data size + avtp headers (PDU_SIZE), ethernet
		 * headers, IPG etc.
		 *
		 * Credits are in bits
		 */
		int tx_sz = payload_sz + sizeof(struct avtp_stream_pdu) + L1_SZ + L2_SZ + VLAN_SZ;
		ninfo.credit -= tx_sz*8;

		k_sem_give(&cbs_credit_lock);
		return 0;
	}
	return -EBUSY;
}

static void clear_data(struct avb_sensor_data *data)
{
	if (!data)
		return;
	memset(data->accel, 0, 3 * sizeof(struct sensor_value));
	memset(data->gyro , 0, 3 * sizeof(struct sensor_value));
	memset(data->magn , 0, 3 * sizeof(struct sensor_value));
	memset(&data->temp , 0,     sizeof(struct sensor_value));
	data->accel_ts = 0;
	data->accel_ctr = 0;
	data->gyro_ts = 0;
	data->gyro_ctr = 0;
}

int pdu_add_data(struct avb_sensor_data *data, struct avtp_stream_pdu *pdu)
{
	if (!data || !pdu)
		return -EINVAL;;

	if (data_get(data) == 0) {
		if (!data->running) {
			/* We are no longer running */
			data_put(data);
			return -EIO;
		}
		else if (!data->ready) {
			/* data not yet ready (still in startup) */
			data_put(data);
			return -ENODATA;
		}
		/*
		 * if (!(data->accel_ctr == 1 && data->gyro_ctr == 1)) :
		 *
		 * We are not completely in synch with polling
		 * Either we:
		 *  - overproduce (ctr > 1)
		 *  - underproduce (ctr == 0)
		 *
		 * For now, let the receiver handle this and send data
		 * packets at the defined rate.
		 *
		 */

		struct sensor_set *set = (struct sensor_set *)pdu->avtp_payload;
		/* all values are in micro-units */
		for (int i = 0; i < 3; i++) {
			set->magn[i]  = sensor_value_to_micro(&data->magn[i]);
			set->gyro[i]  = sensor_value_to_micro(&data->gyro[i]);
			set->accel[i] = sensor_value_to_micro(&data->accel[i]);
		}
		set->temp = sensor_value_to_micro(&(data->temp));

		/* Copy capture timestamps */
		set->gyro_ts_ns = data->gyro_ts;
		set->accel_ts_ns = data->accel_ts;

		data_put(data);
		return sizeof(*set);
	}

	/* Failed getting data lock */
	return -EBUSY;
}

void gather_net_info(struct net_if *iface, void *user_data)
{
	struct net_info *info = (struct net_info *)user_data;
	if (iface->if_dev->mtu > info->max_mtu)
		info->max_mtu = iface->if_dev->mtu;
}

int network_init(struct avb_sensor_data *sensor_data,
		uint64_t tx_interval_ns,
		enum avb_stream_class sc)
{
	if (!sensor_data)
		return -EINVAL;

	memset(&ninfo, 0, sizeof(ninfo));

	struct net_if *iface = net_if_get_first_by_type(&NET_L2_GET_NAME(ETHERNET));
	if (!iface) {
		printf("Failed getting interface, cannot continue\n");
		return -EINVAL;
	}
	/* Get capabilities, FIXME: verify PTP */
	enum ethernet_hw_caps caps = net_eth_get_hw_capabilities(iface);
	printf("HW Ethernet capabilities: %08x\n", caps);

	struct net_linkaddr *link_addr = net_if_get_link_addr(iface);
	printf("Link_addr length=%d, type=%d MAC=", link_addr->len, link_addr->type);
	for (int i = 0; i<link_addr->len; i++) {
		ninfo.stream_id.u8[i] = link_addr->addr[i];
		printf("%02x:", link_addr->addr[i]);
	}
	printf("\n");
	ninfo.stream_id.u8[6] = (STREAM_ID >> 8) & 0xFF;
	ninfo.stream_id.u8[7] = STREAM_ID & 0xFF;
	printf("StreamID: %016llu (0x%016llx) \n", ninfo.stream_id.u64, ninfo.stream_id.u64);
	/* If we're using an explicit stream-class, create a vlan and
	 * create the context to go with it.
	 */
	if (sc != CLASS_NONE) {
		int ret = net_eth_vlan_enable(iface, CONFIG_NET_VLAN_TAG_AVB);
		if (ret < 0) {
			printf("Failed activating VLAN:%d (%d)",
				CONFIG_NET_VLAN_TAG_AVB, ret);
			return -EINVAL;
		}
		ret = net_context_get(AF_PACKET, SOCK_DGRAM, IPPROTO_RAW, &ninfo.avb_ctx);
		if (ret != 0) {
			printf("Failed getting context for outgoing frames\n");
			return -EINVAL;
		}

		struct sockaddr_ll addr = {
			.sll_family = AF_PACKET,
			.sll_protocol = htons(0x22f0),
			.sll_ifindex = 1,
			.sll_halen = 6,
		};
		ret = net_context_bind(ninfo.avb_ctx,
				(struct sockaddr *)&addr,
				sizeof(struct sockaddr_ll));
		if (ret < 0) {
			printf("Failed binding to context (%d)\n", ret);
			return -EINVAL;
		}

		/* From 802.1BA and friends
		 * (Unless otherwise configured by a network-admin)
		 */
		uint8_t prio = sc == CLASS_A ? 3 : 2;
		ret = net_context_set_option(ninfo.avb_ctx,
					NET_OPT_PRIORITY,
					&prio, sizeof(prio));
		if (ret < 0) {
			printf("Faield setting prio (%u) for context, %d\n", prio, ret);
			return -EINVAL;
		}
	}

	/* 1. Find port rate (portTransmitRate) and max MTU*/
	ninfo.portTxRate = 100000000;
	ninfo.max_mtu = iface->if_dev->mtu;

	ninfo.data = sensor_data;
	ninfo.tx_interval_ns = tx_interval_ns;

	ninfo.sc = sc;
	ninfo.maxFrameSize = (PDU_SIZE + L2_SZ + VLAN_SZ + L1_SZ)*8;

	/* idleSlope is the rate of refill and is the total size * observation interval.
	 *
	 * The idea being that a stream should send with /at least/ that rate.
	 *
	 * There's nothing wrong by using expected Tx rate instead of
	 * observation interval per. se, but this will interfere with
	 * the transmission guarantees for other streams. Idle slope is
	 * what gives the upper limit of frame sizes.
	 *
	 * However, as a means for refilling credits in a small system
	 * running in /software/ this approach is competely bonkers.
	 *
	 * The "correct" approach would be to take each dataset and
	 * split it into tx_interval_ns / observation_interval. With our
	 * PDU size of 104 bytes, this would lead to 1-2 bytes of
	 * payload *per* frame which is rather ridiculous.
	 *
	 * So we cheat. As long as sensor_data is < max MTU, we send
	 * everything in a single frame and refill credits based on
	 * tx_interval.
	 */
	ninfo.idleSlope = ninfo.maxFrameSize * ((double)1e9 / ninfo.tx_interval_ns);
	ninfo.sendSlope = ninfo.idleSlope - ninfo.portTxRate;

	/* We implement CBS in SW, so use a timer with a known period and scale refill to this period.
	 *
	 * Note: we do not know the /exact/ time between two timers
	 * fire, but it should be a periodic timer, so over time it
	 * should be correct.
	 */
	ninfo.idleSlope_period_ns = 1000 * NSEC_PER_USEC;
	ninfo.idleSlope_rate = 1000000000L / ninfo.idleSlope_period_ns;
	if (ninfo.idleSlope % ninfo.idleSlope_rate) {
		printf("WARNING! We have fractional idleSlope rate!\n");
		printf("Filling every round: %llu\n",  ninfo.idleSlope / ninfo.idleSlope_rate);
		printf("Remainder: %f\n", (double)(ninfo.idleSlope % ninfo.idleSlope_rate)/ninfo.idleSlope_rate);
	}
	ninfo.idleSlope_refill = ninfo.idleSlope / ninfo.idleSlope_rate;


	/* Need to do jump through some hoops to avoid integer overflow */
	ninfo.loCredit = ((int64_t)ninfo.maxFrameSize * ninfo.sendSlope) / (int64_t)ninfo.portTxRate;
	ninfo.hiCredit = ((int64_t)ninfo.max_mtu * 8  * (ninfo.idleSlope) / (int64_t)ninfo.portTxRate);

	printf("Network CBS settings\n");
	printf("  portTxRate          = %10"PRIu64" bps\n", ninfo.portTxRate);
	printf("  idleSlope           = %10"PRId64" bps\n", ninfo.idleSlope);
	printf("  sendSlope           = %10"PRId64" bps\n", ninfo.sendSlope);
	printf("  loCredit            = %10d bits\n", ninfo.loCredit);
	printf("  hiCredit            = %10d bits\n", ninfo.hiCredit);
	printf("  maxFrameSize        = %10d bits\n", ninfo.maxFrameSize);
	printf("  maxInterferenceSize = %10d bytes\n", ninfo.max_mtu);
	printf("Driver settings:\n");
	printf("  refillPeriod        = %13.2f us\n", ninfo.idleSlope_period_ns/1e3);
	printf("  refillRate          = %10d refills/sec\n", ninfo.idleSlope_rate);
	printf("  refillAmount        = %10d bits/round\n", ninfo.idleSlope_refill);
	return 0;
}

void avb_tx_callback(struct net_context *ctx, int status, void *data)
{
	struct net_info *n = (struct net_info *)data;
	if (ctx == n->avb_ctx) {
		cbs_credit_put(status > 0 ? status : 0);
	}
}

void network_sender(void)
{
	/* Wait for network_init() to be called, i.e. setting ->data */
	do {
		k_sleep(K_MSEC(100));
	} while (ninfo.data == NULL);

	uint8_t seq_num = 0;

	/*
	 * Regardless of context and stream-classes, weneed a convenient
	 * way of draining the receive buffer since gPTP opens the NIC
	 * in promiscous mode.
	 */
	int avb_socket = zsock_socket(AF_PACKET, SOCK_DGRAM, 0x22f0);
	if (avb_socket < 0) {
		printf("[NETWORK] Cannot create socket (%d), aborting\n", avb_socket);
		return;
	}

	/* Set destination */
	const unsigned char ether_mcast_addr[] = {0x01, 0x00, 0x5E, 0x01, 0x11, 0x42};

	struct sockaddr_ll addr;
	addr.sll_family = AF_PACKET;
	addr.sll_ifindex = 1;
	addr.sll_protocol = 0xf022;
	addr.sll_halen = sizeof("xx:xx:xx:xx:xx:xx");
	memcpy(addr.sll_addr, ether_mcast_addr, sizeof(ether_mcast_addr));


	struct avtp_stream_pdu *pdu = alloca(PDU_SIZE);
	avtp_stream_pdu_init(pdu);
	char drain_buffer[1500];

	/* Wait for data to become ready, max 30 sec */
	int ret = data_wait_ready(ninfo.data, 30000);
	if (ret < 0) {
		printf("[NETWORK] Data not available (%d), aborting Tx-thread after 30 sec timeout.\n", ret);
		return;
	}

	while (data_valid(ninfo.data)) {
		/* 1. Block until we have 0 or positive credit */
		cbs_credit_get();

		/* 2. Collect data from _data */
		int sz = pdu_add_data(ninfo.data, pdu);
		if (sz == DATA_LEN) {

			/* 3. Construct rest of PDU */
			avtp_stream_pdu_set(pdu, AVTP_STREAM_FIELD_STREAM_ID, ninfo.stream_id.u64);
			avtp_stream_pdu_set(pdu, AVTP_STREAM_FIELD_STREAM_DATA_LEN, sz);
			avtp_stream_pdu_set(pdu, AVTP_STREAM_FIELD_SEQ_NUM, seq_num);

			/* FIXME: validate gptp, is TV valid? */
			uint64_t ptp_time_ns = gptp_ts();
			uint32_t avtptime = (uint32_t)(ptp_time_ns & 0xffffffff);
			avtp_stream_pdu_set(pdu, AVTP_STREAM_FIELD_TV, 1);
			avtp_stream_pdu_set(pdu, AVTP_STREAM_FIELD_TIMESTAMP, avtptime);

			/* 4. Transmit data  */
			((struct sensor_set *)pdu->avtp_payload)->sent_ts_ns = gptp_ts();
			if (ninfo.sc == CLASS_NONE) {
				zsock_sendto(avb_socket, pdu, PDU_SIZE, 0, (struct sockaddr *)&addr, sizeof(addr));
				cbs_credit_put(sz > 0 ? sz : 0);
			} else {
				int ret = net_context_sendto(ninfo.avb_ctx,
							pdu,
							PDU_SIZE,
							(struct sockaddr *)&addr,
							sizeof(addr),
							(net_context_send_cb_t)avb_tx_callback, K_NO_WAIT, (void *)&ninfo);
				// cbs_credit_puts() freed in callback
				if (ret < 0) {
					printf("Failed sending data using context, res=%d, stopping.\n", ret);
					ninfo.data->running = false;
				}
			}

			/* Rip out multiple messages quickly.
			 *
			 * We are sending L2 packets alongside gPTP,
			 * which places the iface in promiscous
			 * mode. This means that packets sent will end
			 * up in the receive queue, so we need to drain
			 * these to avoid filling up the Rx buffers
			 *
			 * https://github.com/zephyrproject-rtos/zephyr/issues/34865 (Einar's)
			 * https://github.com/zephyrproject-rtos/zephyr/issues/34462
			 * https://github.com/zephyrproject-rtos/zephyr/pull/34475
			 */
			int res;
			do {
				res = recv(avb_socket, drain_buffer, sizeof(drain_buffer), MSG_DONTWAIT);
			} while (res > 0);

			seq_num++;
		}

	}
}
```

## src/util.h
```c
/*
 * Copyright (c) 2017, Intel Corporation
 *
 * Redistribution and use in source and binary forms, with or without
 * modification, are permitted provided that the following conditions are met:
 *
 *    * Redistributions of source code must retain the above copyright notice,
 *      this list of conditions and the following disclaimer.
 *    * Redistributions in binary form must reproduce the above copyright
 *      notice, this list of conditions and the following disclaimer in the
 *      documentation and/or other materials provided with the distribution.
 *    * Neither the name of Intel Corporation nor the names of its contributors
 *      may be used to endorse or promote products derived from this software
 *      without specific prior written permission.
 *
 * THIS SOFTWARE IS PROVIDED BY THE COPYRIGHT HOLDERS AND CONTRIBUTORS "AS IS"
 * AND ANY EXPRESS OR IMPLIED WARRANTIES, INCLUDING, BUT NOT LIMITED TO, THE
 * IMPLIED WARRANTIES OF MERCHANTABILITY AND FITNESS FOR A PARTICULAR PURPOSE ARE
 * DISCLAIMED. IN NO EVENT SHALL THE COPYRIGHT OWNER OR CONTRIBUTORS BE LIABLE
 * FOR ANY DIRECT, INDIRECT, INCIDENTAL, SPECIAL, EXEMPLARY, OR CONSEQUENTIAL
 * DAMAGES (INCLUDING, BUT NOT LIMITED TO, PROCUREMENT OF SUBSTITUTE GOODS OR
 * SERVICES; LOSS OF USE, DATA, OR PROFITS; OR BUSINESS INTERRUPTION) HOWEVER
 * CAUSED AND ON ANY THEORY OF LIABILITY, WHETHER IN CONTRACT, STRICT LIABILITY,
 * OR TORT (INCLUDING NEGLIGENCE OR OTHERWISE) ARISING IN ANY WAY OUT OF THE USE
 * OF THIS SOFTWARE, EVEN IF ADVISED OF THE POSSIBILITY OF SUCH DAMAGE.
 */

#pragma once

//#define BIT(n)				(1ULL << n)

#define BITMASK(len)			(BIT(len) - 1)

/* Get value from the bits within 'bitmap' represented by 'mask'. The 'mask'
 * parameter must be a continuous bit mask (e.g. 0b00111000). This macro
 * doesn't work with non-continuous bit masks (e.g. 0b00101001).
 */
#define BITMAP_GET_VALUE(bitmap, mask, shift) \
			((bitmap & mask) >> shift)

/* Set the value 'val' in the 'bitmap' variable at the position represented by
 * 'mask'.
 */
#define BITMAP_SET_VALUE(bitmap, val, mask, shift) \
			(bitmap = (bitmap & ~mask) | ((val << shift) & mask))

struct __una_u32 { uint32_t x; } __attribute__((packed));

static inline uint32_t get_unaligned_be32(const void *p)
{
	const struct __una_u32 *ptr = (const struct __una_u32 *)p;
	return ntohl(ptr->x);
}

static inline void put_unaligned_be32(uint32_t val, void *p)
{
	struct __una_u32 *ptr = (struct __una_u32 *)p;
	ptr->x = htonl(val);
}
```
